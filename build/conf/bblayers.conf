## build/conf/bblayers.conf
```bitbake
# POKY_BBLAYERS_CONF_VERSION is increased each time build/conf/bblayers.conf
# changes incompatibly
POKY_BBLAYERS_CONF_VERSION = "2"

BBPATH = "${TOPDIR}"
BBFILES ?= ""

BBLAYERS ?= " \
  /home/sarthak/Desktop/yocto/poky/meta \
  /home/sarthak/Desktop/yocto/poky/meta-poky \
  /home/sarthak/Desktop/yocto/poky/meta-yocto-bsp \
  /home/sarthak/Desktop/yocto/poky/meta-ivi \
  "
```

## meta-raspberrypi/conf/machine/raspberrypi3-64.conf
```bitbake
#@TYPE: Machine
#@NAME: RaspberryPi 3 Development Board
#@DESCRIPTION: Machine configuration for the RaspberryPi 3 in 64 bits mode

MACHINEOVERRIDES =. "raspberrypi3:"

MACHINE_EXTRA_RRECOMMENDS += "\
    linux-firmware-rpidistro-bcm43430 \
    linux-firmware-rpidistro-bcm43455 \
    bluez-firmware-rpidistro-bcm43430a1-hcd \
    bluez-firmware-rpidistro-bcm4345c0-hcd \
"

require conf/machine/include/arm/armv8a/tune-cortexa53.inc
include conf/machine/include/rpi-base.inc

RPI_KERNEL_DEVICETREE = " \
    broadcom/bcm2710-rpi-3-b.dtb \
    broadcom/bcm2710-rpi-3-b-plus.dtb \
    broadcom/bcm2837-rpi-3-b.dtb \
    broadcom/bcm2710-rpi-cm3.dtb \
    "

SDIMG_KERNELIMAGE ?= "kernel8.img"
# When u-boot is enabled we need to use the "Image" format and the "booti"
# command to load the kernel
KERNEL_IMAGETYPE_UBOOT ?= "Image"
# "zImage" not supported on arm64 and ".gz" images not supported by bootloader yet
KERNEL_IMAGETYPE_DIRECT ?= "Image"
KERNEL_BOOTCMD ?= "booti"
UBOOT_MACHINE = "rpi_arm64_config"
SERIAL_CONSOLES ?= "115200;ttyS0"

VC4DTBO ?= "vc4-fkms-v3d"
ARMSTUB ?= "armstub8.bin"

# Enable UART
ENABLE_UART = "1"

# Enable U-Boot logo
RPI_USE_U_BOOT = "1"

# Disable splash screen
DISABLE_RPI_BOOT_LOGO = "1"
DISABLE_SPLASH = "1"

# Add extra config to disable Bluetooth and enable UART
RPI_EXTRA_CONFIG:append = "\n\
dtoverlay=disable-bt\n\
"
```
